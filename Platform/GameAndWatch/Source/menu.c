#include "menu.h"
#include "games.h"
#include "display.h"
#include "buttons.h"
#include "stm32h7xx_hal.h"

#include <stdbool.h>
#include <stdint.h>
#include <string.h>


static uint8_t buffer[1024];
static int general_index = 0;
static int screen_index = 0;
static int ok = 0;


static inline bool getPixel(int row, int col)
{
    if (row >= 0 && row <= 63 && col >= 0 && col <= 127)
        return (buffer[(128 * row + col) / 8] >> (7 - (col % 8))) & 1;
    else
        return 0;
}


static inline void setPixel(int row, int col)
{
    if (row >= 0 && row <= 63 && col >= 0 && col <= 127)
        buffer[(128 * row + col) / 8] |= (1 << (7 - (col % 8)));
}


static inline void clearPixel(int row, int col)
{
    if (row >= 0 && row <= 63 && col >= 0 && col <= 127)
        buffer[(128 * row + col) / 8] &= ~(1 << (7 - (col % 8)));
}


static const uint8_t font[] =
{
    0x06, // char width
    0x08, // char height
    0x20, // first char
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    0x00, 0x00, 0x06, 0x09, 0x09, 0x06    // ~
};


static void printChar(int tile_row, int tile_col, char character)
{
    uint8_t byte;

    for (int col = 0; col <= 5; col++)
    {
        byte = font[4 + (character - 32) * 6 + col];

        for (int row = 0; row <= 7; row++)
        {
            if (byte & 1)
            {
                setPixel(tile_row * 8 + row, tile_col * 6 + col);
            }

            byte >>= 1;
        }
    }
}


static void printGameName(int tile_row, unsigned int game)
{
    int size = strlen(GameList[game]->GameName);

    if (size > 21)
    {
        size = 21;
    }

    for (int i = 0; i < size; i++)
    {
        printChar(tile_row, i + 2, (GameList[game]->GameName)[i]);
    }
}

static void sanitizeIndexes()
{
    if (general_index < 0)
    {
        general_index = 0;
    }

    if (general_index > GameCount - 1)
    {
        general_index = GameCount - 1;
    }

    if (screen_index < 0)
    {
        screen_index = 0;
    }

    if (screen_index > GameCount - 8)
    {
        screen_index = GameCount - 8;
    }
}


static void printMenu()
{
    memset(buffer, 0, 1024);

    for (int i = 0; i <= 7; i++)
    {
        printGameName(i, screen_index + i);
    }

    printChar(general_index - screen_index, 0, '>');

    displayRefresh(buffer);
}


static void buttonUp()
{
    general_index--;

    if (general_index < screen_index)
    {
        screen_index--;
    }
}


static void buttonDown()
{
    general_index++;

    if (general_index > screen_index + 7)
    {
        screen_index++;
    }
}


static char button_up_state = 'R';
static char button_down_state = 'R';
static char button_ok_state = 'R';
static unsigned long last_btn_up_press_millis = 0;
static unsigned long last_btn_down_press_millis = 0;
static unsigned long last_btn_ok_press_millis = 0;


static void processInput()
{
    unsigned long current_millis = HAL_GetTick();

    uint32_t buttons = buttons_get();

    if (buttons & B_Up)
    {
        if (button_up_state == 'R')
        {
            button_up_state = 'P';
            last_btn_up_press_millis = current_millis;
        }
    }
    else
    {
        button_up_state = 'R';
    }

    if (buttons & B_Down)
    {
        if (button_down_state == 'R')
        {
            button_down_state = 'P';
            last_btn_down_press_millis = current_millis;
        }
    }
    else
    {
        button_down_state = 'R';
    }

    if (buttons & B_A)
    {
        if (button_ok_state == 'R')
        {
            button_ok_state = 'P';
            last_btn_ok_press_millis = current_millis;
        }
    }
    else
    {
        button_ok_state = 'R';
    }

    if ((button_up_state == 'P') && (current_millis > (last_btn_up_press_millis + 10)))
    {
        button_up_state = 'A';
        buttonUp();
    }

    if ((button_down_state == 'P') && (current_millis > (last_btn_down_press_millis + 10)))
    {
        button_down_state = 'A';
        buttonDown();
    }

    if ((button_ok_state == 'P') && (current_millis > (last_btn_ok_press_millis + 10)))
    {
        button_ok_state = 'A';
        ok = 1;
    }
}


unsigned int menuSelectGame()
{
    general_index = 0;
    screen_index = 0;
    ok = 0;

    while (!ok)
    {
        printMenu();
        processInput();
        sanitizeIndexes();
    }

    return general_index;
}
